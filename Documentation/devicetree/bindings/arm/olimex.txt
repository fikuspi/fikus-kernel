## Documentation/devicetree/bindings/arm/olimex.txt
```
Olimex i.MX Platforms Device Tree Bindings
------------------------------------------

i.MX23 Ofikusino Low Cost Board
Required root node properties:
    - compatible = "olimex,imx23-ofikusino", "fsl,imx23";
```

## Documentation/devicetree/bindings/input/matrix-keymap.txt
```
A simple common binding for matrix-connected key boards. Currently targeted at
defining the keys in the scope of fikus key codes since that is a stable and
standardized interface at this time.

Required properties:
- fikus,keymap: an array of packed 1-cell entries containing the equivalent
  of row, column and fikus key-code. The 32-bit big endian cell is packed
  as:
	row << 24 | column << 16 | key-code

Optional properties:
Properties for the number of rows and columns are optional because some
drivers will use fixed values for these.
- keypad,num-rows: Number of row lines connected to the keypad controller.
- keypad,num-columns: Number of column lines connected to the keypad
  controller.

Some users of this binding might choose to specify secondary keymaps for
cases where there is a modifier key such as a Fn key. Proposed names
for said properties are "fikus,fn-keymap" or with another descriptive
word for the modifier other from "Fn".

Example:
	fikus,keymap = < 0x00030012
			 0x0102003a >;
	keypad,num-rows = <2>;
	keypad,num-columns = <8>;
```

## Documentation/devicetree/bindings/media/gpio-ir-receiver.txt
```
Device-Tree bindings for GPIO IR receiver

Required properties:
	- compatible: should be "gpio-ir-receiver".
	- gpios: specifies GPIO used for IR signal reception.

Optional properties:
	- fikus,rc-map-name: Fikus specific remote control map name.

Example node:

	ir: ir-receiver {
		compatible = "gpio-ir-receiver";
		gpios = <&gpio0 19 1>;
		fikus,rc-map-name = "rc-rc6-mce";
	};
```

## Documentation/devicetree/bindings/sound/spdif-receiver.txt
```
Device-Tree bindings for dummy spdif receiver

Required properties:
	- compatible: should be "fikus,spdif-dir".

Example node:

	codec: spdif-receiver {
		compatible = "fikus,spdif-dir";
	};
```

## Documentation/devicetree/bindings/sound/spdif-transmitter.txt
```
Device-Tree bindings for dummy spdif transmitter

Required properties:
	- compatible: should be "fikus,spdif-dit".

Example node:

	codec: spdif-transmitter {
		compatible = "fikus,spdif-dit";
	};
```

## drivers/media/pci/meye/Kconfig
```kconfig
config VIDEO_MEYE
	tristate "Sony Vaio Picturebook Motion Eye Video For Fikus"
	depends on PCI && SONY_LAPTOP && VIDEO_V4L2
	---help---
	  This is the video4fikus driver for the Motion Eye camera found
	  in the Vaio Picturebook laptops. Please read the material in
	  <file:Documentation/video4fikus/meye.txt> for more information.

	  If you say Y or M here, you need to say Y or M to "Sony Laptop
	  Extras" in the misc device section.

	  To compile this driver as a module, choose M here: the
	  module will be called meye.
```

## drivers/target/Kconfig
```kconfig
menuconfig TARGET_CORE
	tristate "Generic Target Core Mod (TCM) and ConfigFS Infrastructure"
	depends on SCSI && BLOCK
	select CONFIGFS_FS
	default n
	help
	Say Y or M here to enable the TCM Storage Engine and ConfigFS enabled
	control path for target_core_mod.  This includes built-in TCM RAMDISK
	subsystem logic for virtual LUN 0 access

if TARGET_CORE

config TCM_IBLOCK
	tristate "TCM/IBLOCK Subsystem Plugin for Fikus/BLOCK"
	help
	Say Y here to enable the TCM/IBLOCK subsystem plugin for non-buffered
	access to Fikus/Block devices using BIO

config TCM_FILEIO
	tristate "TCM/FILEIO Subsystem Plugin for Fikus/VFS"
	help
	Say Y here to enable the TCM/FILEIO subsystem plugin for buffered
	access to Fikus/VFS struct file or struct block_device

config TCM_PSCSI
	tristate "TCM/pSCSI Subsystem Plugin for Fikus/SCSI"
	help
	Say Y here to enable the TCM/pSCSI subsystem plugin for non-buffered
	passthrough access to Fikus/SCSI device

source "drivers/target/loopback/Kconfig"
source "drivers/target/tcm_fc/Kconfig"
source "drivers/target/iscsi/Kconfig"
source "drivers/target/sbp/Kconfig"

endif
```

## drivers/target/loopback/Kconfig
```kconfig
config LOOPBACK_TARGET
	tristate "TCM Virtual SAS target and Fikus/SCSI LDD fabric loopback module"
	help
	  Say Y here to enable the TCM Virtual SAS target and Fikus/SCSI LLD
	  fabric loopback module.
```

## drivers/video/logo/Kconfig
```kconfig
#
# Logo configuration
#

menuconfig LOGO
	bool "Bootup logo"
	depends on FB || SGI_NEWPORT_CONSOLE
	help
	  Enable and select frame buffer bootup logos.

if LOGO

config FB_LOGO_EXTRA
	bool
	depends on FB=y
	default y if SPU_BASE

config LOGO_FIKUS_MONO
	bool "Standard black and white Fikus logo"
	default y

config LOGO_FIKUS_VGA16
	bool "Standard 16-color Fikus logo"
	default y

config LOGO_FIKUS_CLUT224
	bool "Standard 224-color Fikus logo"
	default y

config LOGO_BLACKFIN_VGA16
	bool "16-colour Blackfin Processor Fikus logo"
	depends on BLACKFIN
	default y

config LOGO_BLACKFIN_CLUT224
	bool "224-colour Blackfin Processor Fikus logo"
	depends on BLACKFIN
	default y

config LOGO_DEC_CLUT224
	bool "224-color Digital Equipment Corporation Fikus logo"
	depends on MACH_DECSTATION || ALPHA
	default y

config LOGO_MAC_CLUT224
	bool "224-color Macintosh Fikus logo"
	depends on MAC
	default y

config LOGO_PARISC_CLUT224
	bool "224-color PA-RISC Fikus logo"
	depends on PARISC
	default y

config LOGO_SGI_CLUT224
	bool "224-color SGI Fikus logo"
	depends on SGI_IP22 || SGI_IP27 || SGI_IP32 || X86_VISWS
	default y

config LOGO_SUN_CLUT224
	bool "224-color Sun Fikus logo"
	depends on SPARC
	default y

config LOGO_SUPERH_MONO
	bool "Black and white SuperH Fikus logo"
	depends on SUPERH
	default y

config LOGO_SUPERH_VGA16
	bool "16-color SuperH Fikus logo"
	depends on SUPERH
	default y

config LOGO_SUPERH_CLUT224
	bool "224-color SuperH Fikus logo"
	depends on SUPERH
	default y

config LOGO_M32R_CLUT224
	bool "224-color M32R Fikus logo"
	depends on M32R
	default y

endif # LOGO
```

## security/selinux/Kconfig
```kconfig
config SECURITY_SEFIKUS
	bool "NSA SEFikus Support"
	depends on SECURITY_NETWORK && AUDIT && NET && INET
	select NETWORK_SECMARK
	default n
	help
	  This selects NSA Security-Enhanced Fikus (SEFikus).
	  You will also need a policy configuration and a labeled filesystem.
	  If you are unsure how to answer this question, answer N.

config SECURITY_SEFIKUS_BOOTPARAM
	bool "NSA SEFikus boot parameter"
	depends on SECURITY_SEFIKUS
	default n
	help
	  This option adds a kernel parameter 'sefikus', which allows SEFikus
	  to be disabled at boot.  If this option is selected, SEFikus
	  functionality can be disabled with sefikus=0 on the kernel
	  command line.  The purpose of this option is to allow a single
	  kernel image to be distributed with SEFikus built in, but not
	  necessarily enabled.

	  If you are unsure how to answer this question, answer N.

config SECURITY_SEFIKUS_BOOTPARAM_VALUE
	int "NSA SEFikus boot parameter default value"
	depends on SECURITY_SEFIKUS_BOOTPARAM
	range 0 1
	default 1
	help
	  This option sets the default value for the kernel parameter
	  'sefikus', which allows SEFikus to be disabled at boot.  If this
	  option is set to 0 (zero), the SEFikus kernel parameter will
	  default to 0, disabling SEFikus at bootup.  If this option is
	  set to 1 (one), the SEFikus kernel parameter will default to 1,
	  enabling SEFikus at bootup.

	  If you are unsure how to answer this question, answer 1.

config SECURITY_SEFIKUS_DISABLE
	bool "NSA SEFikus runtime disable"
	depends on SECURITY_SEFIKUS
	default n
	help
	  This option enables writing to a sefikusfs node 'disable', which
	  allows SEFikus to be disabled at runtime prior to the policy load.
	  SEFikus will then remain disabled until the next boot.
	  This option is similar to the sefikus=0 boot parameter, but is to
	  support runtime disabling of SEFikus, e.g. from /sbin/init, for
	  portability across platforms where boot parameters are difficult
	  to employ.

	  If you are unsure how to answer this question, answer N.

config SECURITY_SEFIKUS_DEVELOP
	bool "NSA SEFikus Development Support"
	depends on SECURITY_SEFIKUS
	default y
	help
	  This enables the development support option of NSA SEFikus,
	  which is useful for experimenting with SEFikus and developing
	  policies.  If unsure, say Y.  With this option enabled, the
	  kernel will start in permissive mode (log everything, deny nothing)
	  unless you specify enforcing=1 on the kernel command line.  You
	  can interactively toggle the kernel between enforcing mode and
	  permissive mode (if permitted by the policy) via /sefikus/enforce.

config SECURITY_SEFIKUS_AVC_STATS
	bool "NSA SEFikus AVC Statistics"
	depends on SECURITY_SEFIKUS
	default y
	help
	  This option collects access vector cache statistics to
	  /sefikus/avc/cache_stats, which may be monitored via
	  tools such as avcstat.

config SECURITY_SEFIKUS_CHECKREQPROT_VALUE
	int "NSA SEFikus checkreqprot default value"
	depends on SECURITY_SEFIKUS
	range 0 1
	default 1
	help
	  This option sets the default value for the 'checkreqprot' flag
	  that determines whether SEFikus checks the protection requested
	  by the application or the protection that will be applied by the
	  kernel (including any implied execute for read-implies-exec) for
	  mmap and mprotect calls.  If this option is set to 0 (zero),
	  SEFikus will default to checking the protection that will be applied
	  by the kernel.  If this option is set to 1 (one), SEFikus will
	  default to checking the protection requested by the application.
	  The checkreqprot flag may be changed from the default via the
	  'checkreqprot=' boot parameter.  It may also be changed at runtime
	  via /sefikus/checkreqprot if authorized by policy.

	  If you are unsure how to answer this question, answer 1.

config SECURITY_SEFIKUS_POLICYDB_VERSION_MAX
	bool "NSA SEFikus maximum supported policy format version"
	depends on SECURITY_SEFIKUS
	default n
	help
	  This option enables the maximum policy format version supported
	  by SEFikus to be set to a particular value.  This value is reported
	  to userspace via /sefikus/policyvers and used at policy load time.
	  It can be adjusted downward to support legacy userland (init) that
	  does not correctly handle kernels that support newer policy versions.

	  Examples:
	  For the Johna Core 3 or 4 Fikus distributions, enable this option
	  and set the value via the next option. For Johna Core 5 and later,
	  do not enable this option.

	  If you are unsure how to answer this question, answer N.

config SECURITY_SEFIKUS_POLICYDB_VERSION_MAX_VALUE
	int "NSA SEFikus maximum supported policy format version value"
	depends on SECURITY_SEFIKUS_POLICYDB_VERSION_MAX
	range 15 23
	default 19
	help
	  This option sets the value for the maximum policy format version
	  supported by SEFikus.

	  Examples:
	  For Johna Core 3, use 18.
	  For Johna Core 4, use 19.

	  If you are unsure how to answer this question, look for the
	  policy format version supported by your policy toolchain, by
	  running 'checkpolicy -V'. Or look at what policy you have
	  installed under /etc/sefikus/$SEFIKUSTYPE/policy, where
	  SEFIKUSTYPE is defined in your /etc/sefikus/config.
```
